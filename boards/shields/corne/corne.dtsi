#include <dt-bindings/zmk/matrix_transform.h>

#include <layouts/foostan/corne/6column.dtsi>

&kscan0 {

        diode_direction = "row2col";
        col_gpios
                = <&pro_micro 2 (GPIO_PULL_DOWN | GPIO_ACTIVE_HIGH)>
                , <&pro_micro 3 (GPIO_PULL_DOWN | GPIO_ACTIVE_HIGH)>
                , <&pro_micro 4 (GPIO_PULL_DOWN | GPIO_ACTIVE_HIGH)>
                , <&pro_micro 5 (GPIO_PULL_DOWN | GPIO_ACTIVE_HIGH)>
                , <&pro_micro 6 (GPIO_PULL_DOWN | GPIO_ACTIVE_HIGH)>
                , <&pro_micro 7 (GPIO_PULL_DOWN | GPIO_ACTIVE_HIGH)>
                ;
        row-gpios
                = <&pro_micro 20 GPIO_ACTIVE_HIGH>
                , <&pro_micro 19 GPIO_ACTIVE_HIGH>
                , <&pro_micro 18 GPIO_ACTIVE_HIGH>
                , <&pro_micro 21 GPIO_ACTIVE_HIGH>
                ;
        };

