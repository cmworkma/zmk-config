## config/Kconfig.shield
```kconfig
# Copyright (c) 2020 Pete Johanson
# SPDX-License-Identifier: MIT

config SHIELD_CHORNE_LEFT
	def_bool $(shields_list_contains,chorne_left)

config SHIELD_CHORNE_RIGHT
	def_bool $(shields_list_contains,chorne_right)
```
